#include "self_stm32f10x.h"

/**************************************************************************
 * 功能:翻转IO
 * 参数:Pin->目标IO
 * 返回值:无
 * 备注:需要先初始化目标IO为Output模式
 * 2021/7/16   庞碧璋
 ***********************************************************************/
void Pin_Reversal(Pin pin)
{
    if(pin.GPIO->ODR & pin.Pin )
        pin.GPIO->ODR &= ~pin.Pin;
    else
        pin.GPIO->ODR |= pin.Pin;
}

/**************************************************************************
 * 功能:软件延时 ms级别
 * 参数:要延时的时长(ms)
 * 返回值:无
 * 备注:适用于系统频率72MHz
 * 2021/7/16   庞碧璋
 ***********************************************************************/
void soft_delay_ms(volatile uint16_t ms)
{
    while(ms!=0)
    {
        soft_delay_us(1000);
        ms--;
    }
}

/**************************************************************************
 * 功能:软件延时 us级别
 * 参数:要延时的时长(us)
 * 返回值:无
 * 备注:适用于系统频率72MHz
 * 2021/7/16   庞碧璋
 ***********************************************************************/
void soft_delay_us(volatile uint16_t us)
{
  	volatile uint16_t i = 0;
	while(us--)
	{
	    i = 2;
	    while(i--);
	}
}

/**************************************************************************
 * 功能:内存拷贝
 * 参数:
 * content 要拷贝的数据
 * buf 缓存
 * len 长度
 * 返回值:无
 * 2021/7/16   庞碧璋
 ***********************************************************************/
void MemCopy(const uint8_t*content,uint8_t*buf,uint8_t len)
{
    if(content != buf)  //防止重复
    for(uint8_t temp=0;temp<len;temp++)
        buf[temp] = content[temp];
}
